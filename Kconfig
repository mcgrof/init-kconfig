## Kconfig
```kconfig
#
# For a description of the syntax of this configuration file, see:
# https://www.kernel.org/doc/Documentation/kbuild/kconfig-language.txt

mainmenu "$(PROJECT) $(PROJECTRELEASE)"

config FOO
	bool "Foo support"
	help
	  This enables compilation of foo. It is an example of a random
	  component of a project.

config BAR
	bool "Bar support"
	help
	  This enables compilation of the feature bar.

config BAZ
	bool "Baz support"
	depends on BAR
	help
	  This enables baz. It demos dependency annotations.

config ALPHA
	bool "Alpha support"
	help
	  This enables alpha. An example directory depenency.
```
